## configs/mvebu_armv8_espressobin_defconfig
```kconfig
BR2_aarch64=y
BR2_CCACHE=y
BR2_OPTIMIZE_2=y
BR2_TOOLCHAIN_BUILDROOT_VENDOR="espressobin"
BR2_TOOLCHAIN_BUILDROOT_MUSL=y
BR2_GCC_VERSION_7_X=y
BR2_TOOLCHAIN_BUILDROOT_CXX=y
BR2_GCC_ENABLE_LTO=y
BR2_PACKAGE_HOST_GDB=y
BR2_PACKAGE_HOST_GDB_TUI=y
BR2_PACKAGE_HOST_GDB_PYTHON=y
BR2_TARGET_GENERIC_HOSTNAME="espressobin"
BR2_TARGET_GENERIC_ISSUE="Welcome to the ZeroSystem"
BR2_TARGET_GENERIC_PASSWD_SHA256=y
BR2_ROOTFS_DEVICE_CREATION_DYNAMIC_EUDEV=y
BR2_TARGET_GENERIC_ROOT_PASSWD="espressobin"
BR2_SYSTEM_BIN_SH_MKSH=y
BR2_TARGET_TZ_INFO=y
BR2_ROOTFS_OVERLAY="user_files/"
BR2_LINUX_KERNEL=y
BR2_LINUX_KERNEL_DEFCONFIG="mvebu_v8_lsp"
BR2_LINUX_KERNEL_DTS_SUPPORT=y
BR2_LINUX_KERNEL_INTREE_DTS_NAME="marvell/armada-3720-espressobin"
BR2_LINUX_KERNEL_INSTALL_TARGET=y
BR2_PACKAGE_BUSYBOX_SHOW_OTHERS=y
BR2_PACKAGE_BZIP2=y
BR2_PACKAGE_GZIP=y
BR2_PACKAGE_BONNIE=y
BR2_PACKAGE_DHRYSTONE=y
BR2_PACKAGE_FIO=y
BR2_PACKAGE_IOZONE=y
BR2_PACKAGE_LMBENCH=y
BR2_PACKAGE_MEMSTAT=y
BR2_PACKAGE_STRACE=y
BR2_PACKAGE_STRESS=y
BR2_PACKAGE_WHETSTONE=y
BR2_PACKAGE_FINDUTILS=y
BR2_PACKAGE_FLEX=y
BR2_PACKAGE_GAWK=y
BR2_PACKAGE_GREP=y
BR2_PACKAGE_MAKE=y
BR2_PACKAGE_PATCH=y
BR2_PACKAGE_SED=y
BR2_PACKAGE_TREE=y
BR2_PACKAGE_BTRFS_PROGS=y
BR2_PACKAGE_CPIO=y
BR2_PACKAGE_CRAMFS=y
BR2_PACKAGE_DOSFSTOOLS=y
BR2_PACKAGE_DOSFSTOOLS_MKFS_FAT=y
BR2_PACKAGE_E2FSPROGS_DEBUGFS=y
BR2_PACKAGE_E2FSPROGS_RESIZE2FS=y
BR2_PACKAGE_MTD=y
BR2_PACKAGE_MTD_JFFS2DUMP=y
BR2_PACKAGE_MTD_MKFSJFFS2=y
BR2_PACKAGE_MTD_MKFSUBIFS=y
BR2_PACKAGE_NFS_UTILS=y
BR2_PACKAGE_DEVMEM2=y
BR2_PACKAGE_HDPARM=y
BR2_PACKAGE_I2C_TOOLS=y
BR2_PACKAGE_IOSTAT=y
BR2_PACKAGE_LM_SENSORS=y
BR2_PACKAGE_LM_SENSORS_SENSORS_DETECT=y
BR2_PACKAGE_LSHW=y
BR2_PACKAGE_MDADM=y
BR2_PACKAGE_MEMTESTER=y
BR2_PACKAGE_PARTED=y
BR2_PACKAGE_SDPARM=y
BR2_PACKAGE_SMARTMONTOOLS=y
BR2_PACKAGE_SYSSTAT=y
BR2_PACKAGE_PERL=y
BR2_PACKAGE_PYTHON=y
BR2_PACKAGE_OPENSSL_BIN=y
BR2_PACKAGE_LIBAIO=y
BR2_PACKAGE_BC=y
BR2_PACKAGE_ARPTABLES=y
BR2_PACKAGE_BRIDGE_UTILS=y
BR2_PACKAGE_DHCP=y
BR2_PACKAGE_DHCP_CLIENT=y
BR2_PACKAGE_DHCPCD=y
BR2_PACKAGE_ETHTOOL=y
BR2_PACKAGE_IFTOP=y
BR2_PACKAGE_IPTABLES=y
BR2_PACKAGE_LIGHTTPD=y
BR2_PACKAGE_NCFTP=y
BR2_PACKAGE_NETATALK=y
BR2_PACKAGE_NETCAT=y
BR2_PACKAGE_OPENSSH=y
BR2_PACKAGE_RSYNC=y
BR2_PACKAGE_TCPDUMP=y
BR2_PACKAGE_TFTPD=y
BR2_PACKAGE_VSFTPD=y
BR2_PACKAGE_WGET=y
BR2_PACKAGE_WIRESHARK=y
BR2_PACKAGE_BASH=y
BR2_PACKAGE_FILE=y
BR2_PACKAGE_SCREEN=y
BR2_PACKAGE_TIME=y
BR2_PACKAGE_WHICH=y
BR2_PACKAGE_ATTR=y
BR2_PACKAGE_COREUTILS=y
BR2_PACKAGE_FTOP=y
BR2_PACKAGE_HTOP=y
BR2_PACKAGE_IOTOP=y
BR2_PACKAGE_KVMTOOL=y
BR2_PACKAGE_PROCPS_NG=y
BR2_PACKAGE_TAR=y
BR2_PACKAGE_UTIL_LINUX_BINARIES=y
BR2_PACKAGE_UTIL_LINUX_FSCK=y
BR2_PACKAGE_UTIL_LINUX_MOUNT=y
BR2_PACKAGE_UTIL_LINUX_RESET=y
BR2_PACKAGE_LESS=y
BR2_PACKAGE_VIM=y
BR2_TARGET_ROOTFS_TAR_GZIP=y
BR2_PACKAGE_HOST_MKE2IMG=y
BR2_PACKAGE_HOST_UBOOT_TOOLS=y
BR2_PACKAGE_HOST_UBOOT_TOOLS_FIT_SUPPORT=y
BR2_PACKAGE_HOST_UBOOT_TOOLS_FIT_SIGNATURE_SUPPORT=y
```
